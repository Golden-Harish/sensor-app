## app/build/Kconfig/Kconfig.modules
```kconfig
menu "sensor-app (/home/golden-devadhas/zephyrproject/sensor-app)"
osource "/home/golden-devadhas/zephyrproject/sensor-app/Kconfig"
config ZEPHYR_SENSOR_APP_MODULE
	bool
	default y
endmenu
menu "cmsis (/home/golden-devadhas/zephyrproject/modules/hal/cmsis)"
osource "$(ZEPHYR_CMSIS_KCONFIG)"
config ZEPHYR_CMSIS_MODULE
	bool
	default y
endmenu
menu "hal_nordic (/home/golden-devadhas/zephyrproject/modules/hal/nordic)"
osource "$(ZEPHYR_HAL_NORDIC_KCONFIG)"
config ZEPHYR_HAL_NORDIC_MODULE
	bool
	default y

config ZEPHYR_HAL_NORDIC_MODULE_BLOBS
	bool
endmenu
config ZEPHYR_HAL_STM32_MODULE
	bool
	default y

config ZEPHYR_HAL_STM32_MODULE_BLOBS
	bool
```

## app/build/Kconfig/Kconfig.shield
```kconfig
osource "/home/golden-devadhas/zephyrproject/sensor-app/boards/shields/*/Kconfig.shield"
```

## app/build/Kconfig/Kconfig.shield.defconfig
```kconfig
osource "/home/golden-devadhas/zephyrproject/sensor-app/boards/shields/*/Kconfig.defconfig"
```
